/*
  ===========================================================================
  SMART LAB FULL ACCESS CONTROL SYSTEM — V6
  ===========================================================================
  Board: ESP32 Dev Module

  BASE: the known-good RFID build. The entire RFID path is untouched -
  same rfidBeginSpi()/rfidInitReader(), same rfidVersionOk() test, same
  heartbeat, same antenna handling, same PICC_IsNewCardPresent() +
  PICC_ReadCardSerial() polling, same timings, same user database.

  ONLY TWO THINGS CHANGED, both requested:

  1. SMOOTH SCREEN SWITCHING
     Before: every transition did a full-screen clear (all 20,480 pixels on
     a bit-banged bus) and redrew the static header - that is the flash you
     were seeing, and a shorter new string could leave the tail of a longer
     old one behind.
     Now: the clear and the header happen ONCE in tftInit(). Transitions
     repaint only the three content rows (~4x less pixel traffic), and each
     row clears its own full width with fillRect and uses opaque text, so
     leftover characters are impossible.

  2. RELAY ONLY EVER MOVES FOR AN ACCESS GRANT
     - goAccessDenied() no longer touches the relay at all.
     - setRelay() now tracks its own state and SKIPS redundant writes, so
       returning to idle after a denial is a genuine no-op - the pin is not
       rewritten, not re-pinMode'd, nothing.
     - The relay is driven LOCKED as the very first instruction of setup(),
       before Serial, so it is never left floating during boot.
     Result: across a whole denied attempt the relay is never written once.

  WIRING THIS FIRMWARE EXPECTS (unchanged from your working setup):
     Solenoid on the NC contact, GPIO26 wired DIRECTLY to the relay IN pin
     (no transistor - the module is high-triggered and an NPN pulling IN low
     stopped it energizing entirely). Relay VCC + COM on 12V.
     GPIO26 HIGH = LOCKED, GPIO26 LOW = UNLOCKED.
  ===========================================================================
*/

#include <SPI.h>
#include <MFRC522.h>
#include <HardwareSerial.h>
#include <Adafruit_Fingerprint.h>
#include <Adafruit_GFX.h>
#include <Adafruit_ST7735.h>
#include <Fonts/FreeSansBold9pt7b.h>
#include <Fonts/FreeSansBold12pt7b.h>
#include <WiFi.h>
#include <HTTPClient.h>

// ===========================================================================
// >>>>>>>>>>>>>>>>>>>>> STAGE 4: CAMERA INTEGRATION <<<<<<<<<<<<<<<<<<<<<<<<<
// ===========================================================================
// The Master now accepts EITHER factor at each step:
//     Step 1 (identity) : RFID tag/card   OR  QR code via the camera
//     Step 2 (biometric): fingerprint     OR  face via the camera
//
// The camera board is polled over WiFi. Nothing is wired between the boards.
// If the camera or WiFi is unavailable the system degrades gracefully to
// RFID + fingerprint exactly as before - the door never depends on the
// network being up.
// ===========================================================================
// WIFI_SSID, WIFI_PASS and DEVICE_KEY live in secrets.h, which is gitignored.
// Copy secrets.example.h to secrets.h and fill in your values.
#include "secrets.h"

// Optional per-user photos for the ACCESS GRANTED screen, generated by
// firmware/tools/make_lcd_photo.py into this folder (gitignored - it is a
// picture of a person). Without the file, the text screens are used.
#if __has_include("user_photos.h")
#include "user_photos.h"
#else
constexpr int16_t USER_PHOTO_W = 160, USER_PHOTO_H = 128;
// A macro, not a function: the Arduino IDE puts its generated prototypes
// just above the FIRST function in the file, and a function here would put
// them above the structs below ("'QrAuthResult' does not name a type").
#define userPhoto(name) ((const uint16_t *)nullptr)
#endif

// The ESP32-CAM's IP - it prints this on boot ("PUT THIS IN THE MASTER").
const char *CAMERA_IP = "192.168.1.150";

// ===========================================================================
// PORTAL INTEGRATION
// ===========================================================================
// Set BACKEND_ENABLED to false and this sketch behaves EXACTLY like
// SmartLab_Master_Stage5: local RFID + fingerprint + face, no network
// authorization. That is the fallback if the portal is unavailable at a
// demonstration, and it is why the original file is left untouched on disk.
constexpr bool BACKEND_ENABLED = true;

const char *BACKEND_IP   = "192.168.1.8";   // laptop running the portal API
constexpr uint16_t BACKEND_PORT = 8000;

// Must match a lab 'code' in the portal database, and a device_uid.
const char *LAB_ID    = "LAB_01";
const char *DEVICE_ID = "MASTER_LAB01";

// Devices authenticate with a shared key, not a user login: an ESP32 has no
// person to type a password and must survive a reboot unattended.
// DEVICE_KEY (in secrets.h) must match DEVICE_API_KEY in the backend's .env.

// Kept short. Every millisecond here is a millisecond the person is standing
// at the door waiting, and the request happens while they watch.
constexpr uint32_t BACKEND_TIMEOUT_MS   = 2500;
constexpr uint32_t HEARTBEAT_PERIOD_MS  = 30000;

// A portal-issued booking credential always starts with this. Anything else
// is treated as a legacy local payload, which is what keeps the bench demo
// working with the portal switched off.
const char *PORTAL_QR_PREFIX = "SLB:";

constexpr uint32_t CAMERA_POLL_MS   = 100;   // how often to ask the camera
                                             // (/status is tiny; 250 ms added
                                             // up to a quarter second per step)
constexpr uint32_t CAMERA_TIMEOUT_MS = 800; // keep it short: a slow reply
                                             // must never stall the door
// A camera result older than this is IGNORED. Without it, a QR scanned a
// minute ago could let the next person through. This is the single most
// important security constant in the integration.
constexpr uint32_t VISION_FRESH_MS  = 3500;

// ===========================================================================
// PIN ARCHITECTURE
// ===========================================================================

// --- RFID / MFRC522 — VSPI, exclusive use (proven: VersionReg = 0x92) ---
constexpr uint8_t RFID_SS_PIN   = 5;
constexpr uint8_t RFID_RST_PIN  = 22;
constexpr uint8_t RFID_SCK_PIN  = 18;
constexpr uint8_t RFID_MISO_PIN = 19;
constexpr uint8_t RFID_MOSI_PIN = 23;

// --- TFT ST7735 — separate bus, physically isolated from RFID ---
constexpr uint8_t TFT_SCK_PIN  = 13;
constexpr uint8_t TFT_MOSI_PIN = 2;   // NOT GPIO4 (fingerprint wiring uses it)
constexpr uint8_t TFT_CS_PIN   = 25;
constexpr uint8_t TFT_DC_PIN   = 32;
constexpr uint8_t TFT_RST_PIN  = 33;

// --- Fingerprint UART ---
constexpr uint8_t FP_RX_PIN = 16;     // sensor TX -> here
constexpr uint8_t FP_TX_PIN = 17;     // sensor RX -> here

// --- Door sensor (MC-38 reed switch) ---
constexpr uint8_t DOOR_PIN = 27;      // INPUT_PULLUP; LOW=CLOSED, HIGH=OPEN

// --- Relay (HIGH = LOCKED / OFF, LOW = UNLOCKED / ON) ---
constexpr uint8_t RELAY_PIN = 26;
constexpr uint8_t RELAY_LOCKED_LEVEL   = HIGH;
constexpr uint8_t RELAY_UNLOCKED_LEVEL = LOW;

// --- Indicators ---
constexpr uint8_t GREEN_LED_PIN      = 14;
constexpr uint8_t RED_LED_BUZZER_PIN = 21;  // one NPN stage drives red LED + buzzer

// ---------------------------------------------------------------------------
// STANDALONE RED LED - denial feedback WITHOUT the buzzer's current surge.
// The red LED and buzzer currently share one transistor on GPIO21, so neither
// can be used without the other, and the buzzer is what releases the door.
// This pin lets the red LED be driven on its own.
//
// TO USE IT: take the red LED off the transistor collector and wire it as
//     GPIO15 --[220 ohm]-- LED anode ... LED cathode -- GND
// No transistor needed: an LED draws ~15mA and an ESP32 pin handles 40mA.
// 15mA is far too little to sag the rail, so the door stays shut.
//
// Safe to leave enabled with nothing connected - driving an unused pin does
// nothing. So this is already active and will simply start working the moment
// you wire the LED up.
// ---------------------------------------------------------------------------
constexpr uint8_t RED_LED_SOLO_PIN = 15;

MFRC522 mfrc522(RFID_SS_PIN, RFID_RST_PIN);
HardwareSerial fingerSerial(2);
Adafruit_Fingerprint finger(&fingerSerial);
// The TFT runs on the ESP32's SECOND hardware SPI controller (HSPI), routed
// to its own SCK/MOSI pins - still a separate bus from the RFID (VSPI), just
// no longer bit-banged by the CPU. Bit-banging painted a full-screen photo
// line by line; hardware SPI draws it in ~20-30 ms.
// RST is passed as -1 and pulsed by tftInit() itself, so a light wake-up
// (tftWake) can bring the display back WITHOUT a reset pulse.
constexpr uint32_t TFT_SPI_HZ = 20000000;   // 20 MHz; lower if long wires
SPIClass tftSPI(HSPI);
Adafruit_ST7735 tft = Adafruit_ST7735(&tftSPI, TFT_CS_PIN, TFT_DC_PIN, -1);

// ===========================================================================
// Forward declarations — Arduino IDE's auto prototype generator mishandles a
// library-class parameter type (MFRC522::Uid) and emits a broken prototype
// above the #include that defines it. Declaring them here prevents that.
// ===========================================================================
void printUID(const MFRC522::Uid &uid);
bool uidEquals(const MFRC522::Uid &uid, const uint8_t *storedUID, uint8_t storedSize);
bool isSameAsLastUID(const MFRC522::Uid &uid);
void rememberUID(const MFRC522::Uid &uid);
int  findAuthorizedUser(const MFRC522::Uid &uid);

// ===========================================================================
// USER DATABASE — never silently changed
//   USER 1 = TAG  89:52:FF:1F + fingerprint ID 1 (THUMB)
//   USER 2 = CARD F5:77:30:8E + fingerprint ID 2 (INDEX)
// ===========================================================================
struct AuthorizedUser {
  uint8_t size;
  uint8_t uid[10];
  uint8_t fingerprintId;
  const char *name;         // INTERNAL ID - must match the face-recognition
                            // server's enrolled names (USER1 / USER2) so the
                            // two identities can be compared in Stage 4.
                            // Do not change this to a friendly name.
  const char *displayName;  // What the LCD shows. Change this freely.
};

// Portal users beyond this list (USER3, USER4, ... created in the portal)
// need no change here: for a booking QR the portal names the identity, and
// the number in USERn IS the fingerprint slot (enrol with "enroll n" on the
// serial monitor) and the face label. They are loaded into the last entry,
// PORTAL_SLOT, for the duration of one entry attempt. RFID cards stay local:
// only the two users above have a card.
char portalUserName[16]    = "";
char portalUserDisplay[16] = "";

AuthorizedUser authorizedUsers[] = {
  {4, {0x89, 0x52, 0xFF, 0x1F, 0, 0, 0, 0, 0, 0}, 1, "USER1", "ALI"},
  {4, {0xF5, 0x77, 0x30, 0x8E, 0, 0, 0, 0, 0, 0}, 2, "USER2", "DR. RAMY"},
  {0, {0, 0, 0, 0, 0, 0, 0, 0, 0, 0}, 0, portalUserName, portalUserDisplay}  // PORTAL_SLOT
};
// Lookups by card / by name cover the fixed users only, never the portal slot.
constexpr size_t AUTHORIZED_USER_COUNT =
    sizeof(authorizedUsers) / sizeof(authorizedUsers[0]) - 1;
constexpr int    PORTAL_SLOT    = (int)AUTHORIZED_USER_COUNT;
constexpr uint8_t MAX_FINGER_SLOT = 127;   // AS608 capacity on common modules

// Result of asking the portal about a booking QR.
// Defined up here (not next to validateQrWithBackend) because the Arduino IDE
// auto-generates function prototypes above the first function in the file;
// the type must already exist at that point or compilation fails.
struct QrAuthResult {
  bool    valid       = false;
  String  authSubject = "";     // USER1 / USER2 - matches authorizedUsers[].name
  String  displayName = "";
  long    bookingId   = -1;
  String  reason      = "";
};

// ===========================================================================
// Timing constants — unchanged
// ===========================================================================
constexpr uint32_t SERIAL_BAUD            = 115200;
constexpr uint32_t CARD_READ_TIMEOUT_MS   = 250;   // proven value
constexpr uint32_t DUPLICATE_IGNORE_MS    = 1200;  // proven value
constexpr uint32_t POLL_DELAY_MS          = 5;     // proven value
constexpr uint32_t FINGERPRINT_TIMEOUT_MS = 20000;
constexpr uint32_t GRANTED_DISPLAY_MS     = 1500;  // "GRANTED" screen hold time
constexpr uint32_t UNLOCK_HOLD_MS         = 8000;  // safety relock if door never opens
constexpr uint32_t DENIED_DISPLAY_MS      = 2000;  // must be >= DENY_BEEP_MS,
                                                   // otherwise goIdle() cuts
                                                   // the alert short
constexpr uint32_t DOOR_DEBOUNCE_MS       = 100;
constexpr uint32_t RFID_HEARTBEAT_MS      = 3000;  // link self-test interval
// How long the green "QR CODE OK" / "RFID OK" confirmation shows before the
// step-2 prompt replaces it. Display only: face/finger are accepted from
// the first moment of step 2.
constexpr uint32_t STEP1_OK_SHOW_MS       = 1200;
// Door alarms (reed switch). Held-open: a legitimately opened door that is
// not closed within this long raises an alert.
constexpr uint32_t DOOR_HELD_OPEN_MS      = 30000;
// A component check that has not succeeded for this long counts as down.
constexpr uint32_t CAMERA_HEALTHY_MS      = 10000;
constexpr uint32_t FP_HEALTH_CHECK_MS     = 10000;
constexpr uint32_t RELAY_SETTLE_MS        = 80;    // supply settles after the
                                                   // coil switches, before
                                                   // the display is redrawn

// ---------------------------------------------------------------------------
// DENIAL ALERT - buzzer + red LED share one NPN stage on GPIO21.
// Their inrush current sags the supply hard enough to RESET the TFT (white
// screen) and drop the relay coil (door pops). Keeping the pulse SHORT keeps
// the disturbance short. The screen still shows DENIED for the full
// DENIED_DISPLAY_MS - only the audible/visible alert is brief.
// Set DENY_ALERT_ENABLED to false to silence it completely: if the white
// screen and the door pop both disappear, the diagnosis is confirmed.
// ---------------------------------------------------------------------------
// DEFAULT IS false - this is what makes a denial completely harmless:
// with GPIO21 never energized there is no current surge, so the relay cannot
// drop out and the TFT cannot reset. The DENIED message still shows in red on
// the LCD, so the user still gets clear feedback.
// Once a 470-1000uF capacitor is fitted across the 12V rail, set this back to
// true - the soft-start below is already written and will bring the buzzer
// and red LED back without the inrush step that caused the problem.
// FINAL: OFF. Energizing GPIO21 drives the buzzer, and the buzzer's current
// draw sags the 12V rail enough to drop the relay coil and release the door.
// Every variant was tested and every one popped the door: 3000ms, 500ms,
// 150ms, with and without a soft-start ramp. Only disabling it keeps the door
// shut. This is a supply problem (no bulk capacitance on the 12V rail), not a
// firmware problem - fit a 470-1000uF capacitor and this can go back to true.
constexpr bool     DENY_ALERT_ENABLED = false;
// 30ms - a deliberate last attempt, not a normal value.
// A relay armature takes ~5-10ms to release, and the buck converter's output
// capacitor holds the rail up briefly before it droops. So a pulse this short
// may finish before the voltage falls far enough to drop the coil.
// 3000ms, 500ms and 150ms all popped the door; if 30ms does too, no firmware
// timing will fix this and it is purely a supply problem.
constexpr uint32_t DENY_BEEP_MS       = 30;

// ===========================================================================
// State machine
// ===========================================================================
enum SystemState {
  STATE_IDLE,
  STATE_WAIT_FINGERPRINT,
  STATE_ACCESS_GRANTED,
  STATE_DOOR_UNLOCKED_WAIT_OPEN,
  STATE_DOOR_OPEN_WAIT_CLOSE,
  STATE_ACCESS_DENIED,
  STATE_DOOR_ALARM              // door opened while locked (forced entry)
};

SystemState state = STATE_IDLE;
bool        displayDirty = true;    // set on every transition; drives redraw
int         pendingUserIndex = -1;
// Portal context for the identity currently being verified. Reset on every
// return to IDLE so a stale booking can never be attributed to a later entry.
long        pendingBookingId = -1;
bool        pendingViaPortal = false;
uint32_t    lastHeartbeatSentMs = 0;
uint32_t    stateEnteredMs = 0;
const char *deniedReason = "";
char        deniedReasonBuf[40];   // deniedReason points here: the callers'
                                   // strings (e.g. a portal reply) are
                                   // temporaries that die before a redraw

// Display-only state (never consulted by the access logic).
const char *step1Label = "";       // "QR CODE OK" / "RFID OK"
bool        verifyPromptShown = false;
uint32_t    lastVerifyBarMs = 0;

// Door alarms
bool        heldOpenAlarmed = false;

// Component health, sent with the heartbeat so the portal can alert staff.
bool        fpOk = false;
uint32_t    lastFpCheckMs = 0;
uint32_t    lastCameraOkMs = 0;
uint8_t     lastComponentBits = 0xFF;   // forces a report on the first loop
float       visionDistance = 0;

// RFID de-dup tracking (from the proven standalone implementation)
uint8_t  lastUID[10] = {0};
uint8_t  lastUIDSize = 0;
uint32_t lastUIDTime = 0;
bool     haveLastUID = false;

// RFID link health
bool     rfidLinkDown = false;
uint32_t lastHeartbeatMs = 0;

// Latest vision result pulled from the camera board
String   visionQr        = "";
String   visionFace      = "";
bool     visionQrFresh   = false;
bool     visionFaceFresh = false;
bool     cameraOnline    = false;
uint32_t lastCameraPollMs = 0;

// Door tracking (debounced, polled every loop)
bool     doorClosed = true;
uint32_t doorLastChangeMs = 0;
bool     doorChangedThisLoop = false;

// Relay state tracking — lets setRelay() skip redundant writes entirely
bool relayUnlocked   = false;
bool relayEverDriven = false;

// Set whenever a known supply disturbance happens (a relay switch). The
// ST7735 has no readable status register, so a controller reset by a voltage
// sag just sits there white forever with no way to detect it. We cannot see
// it, but we DO know when a disturbance occurred - so we flag it and refresh
// the display later, ONLY once back in IDLE. Gating it on IDLE matters: a
// full re-init is itself a burst of activity, and it must never happen in
// the middle of an unlock/door cycle.
bool tftRefreshWanted = false;

// Denial alert pulse tracking
bool     denyAlertActive  = false;
uint32_t denyAlertStartMs = 0;
bool     denyAlertFired   = false;   // did THIS denial energise GPIO21?


// ===========================================================================
// Diagnostics helpers
// ===========================================================================
void printHexByte(uint8_t value) {
  if (value < 0x10) Serial.print('0');
  Serial.print(value, HEX);
}

void printUID(const MFRC522::Uid &uid) {
  Serial.print("[RFID][UID] ");
  for (byte i = 0; i < uid.size; i++) {
    printHexByte(uid.uidByte[i]);
    if (i < uid.size - 1) Serial.print(':');
  }
  Serial.println();
}

void printErrorRegister() {
  byte errorReg = mfrc522.PCD_ReadRegister(mfrc522.ErrorReg);
  Serial.print("[SPI][ERROR] ErrorReg = 0x");
  printHexByte(errorReg);
  Serial.println();
}

// ===========================================================================
// RFID link health + auto-recovery  —  UNCHANGED from the working build
// ===========================================================================
bool rfidVersionOk(byte v) {
  return !(v == 0x00 || v == 0xFF);
}

// Brings up the SPI bus. Called ONCE, from setup() only.
void rfidBeginSpi() {
  SPI.begin(RFID_SCK_PIN, RFID_MISO_PIN, RFID_MOSI_PIN, RFID_SS_PIN);
  delay(20);
  pinMode(RFID_SS_PIN, OUTPUT);
  digitalWrite(RFID_SS_PIN, HIGH);
}

// (Re)initializes the READER only — safe to call repeatedly.
void rfidInitReader() {
  mfrc522.PCD_Init(RFID_SS_PIN, RFID_RST_PIN);
  delay(50);
  mfrc522.PCD_AntennaOn();
  mfrc522.PCD_SetAntennaGain(MFRC522::RxGain_max);
  delay(10);
}

void printAntennaState(const char *tag) {
  byte tx = mfrc522.PCD_ReadRegister(mfrc522.TxControlReg);
  byte gain = (mfrc522.PCD_GetAntennaGain() >> 4) & 0x07;
  Serial.printf("%s TxControlReg = 0x%02X  [RF field %s]  RxGain level = %u/7\n",
                tag, tx, ((tx & 0x03) == 0x03) ? "ON" : "OFF/PARTIAL", gain);
}

bool rfidRecover() {
  Serial.println("[RFID][RECOVER] Link lost - reinitializing MFRC522 (reader only)...");
  rfidInitReader();
  byte v = mfrc522.PCD_ReadRegister(mfrc522.VersionReg);
  bool ok = rfidVersionOk(v);
  Serial.printf("[RFID][RECOVER] VersionReg = 0x%02X  %s\n",
                v, ok ? "(recovered)" : "(STILL DOWN - check wiring)");
  if (ok) printAntennaState("[RFID][RECOVER]");
  return ok;
}

// ===========================================================================
// RFID helpers — UNCHANGED
// ===========================================================================
bool uidEquals(const MFRC522::Uid &uid, const uint8_t *storedUID, uint8_t storedSize) {
  if (uid.size != storedSize) return false;
  for (byte i = 0; i < uid.size; i++) if (uid.uidByte[i] != storedUID[i]) return false;
  return true;
}

bool isSameAsLastUID(const MFRC522::Uid &uid) {
  if (!haveLastUID || uid.size != lastUIDSize) return false;
  for (byte i = 0; i < uid.size; i++) if (uid.uidByte[i] != lastUID[i]) return false;
  return true;
}

void rememberUID(const MFRC522::Uid &uid) {
  lastUIDSize = uid.size;
  for (byte i = 0; i < uid.size && i < sizeof(lastUID); i++) lastUID[i] = uid.uidByte[i];
  lastUIDTime = millis();
  haveLastUID = true;
}

int findAuthorizedUser(const MFRC522::Uid &uid) {
  for (size_t i = 0; i < AUTHORIZED_USER_COUNT; i++) {
    if (uidEquals(uid, authorizedUsers[i].uid, authorizedUsers[i].size)) return (int)i;
  }
  return -1;
}

bool readCardWithTimeout() {
  uint32_t start = millis();
  while ((millis() - start) < CARD_READ_TIMEOUT_MS) {
    if (mfrc522.PICC_ReadCardSerial()) return true;
    delay(POLL_DELAY_MS);
  }
  Serial.println("[RFID][TIMEOUT] Could not read UID within timeout.");
  printErrorRegister();
  return false;
}

void finishRFIDTransaction() {
  mfrc522.PICC_HaltA();
  mfrc522.PCD_StopCrypto1();
}

// ===========================================================================
// Actuators
// ===========================================================================
// CHANGE 2: the relay is written ONLY when the state actually changes.
// A denied attempt never reaches this function at all, and the goIdle() call
// that follows a denial finds the relay already locked, so it returns
// immediately without touching the pin.
void setRelay(bool unlock) {
  if (relayEverDriven && relayUnlocked == unlock) return;   // already there - do nothing
  pinMode(RELAY_PIN, OUTPUT);
  digitalWrite(RELAY_PIN, unlock ? RELAY_UNLOCKED_LEVEL : RELAY_LOCKED_LEVEL);
  relayUnlocked   = unlock;
  relayEverDriven = true;
  Serial.printf("[RELAY] %s\n", unlock ? "UNLOCKED (GPIO26 LOW)" : "LOCKED (GPIO26 HIGH)");
  // Switching the coil is the biggest current step in the system and is what
  // resets the TFT to white. Flag it; the refresh happens later, in IDLE only.
  tftRefreshWanted = true;
}

void setIndicators(bool green, bool redBuzzer) {
  digitalWrite(GREEN_LED_PIN, green ? HIGH : LOW);
  digitalWrite(RED_LED_BUZZER_PIN, redBuzzer ? HIGH : LOW);
}

// Standalone red LED on its own pin - ~15mA, far too little to disturb the
// relay. Harmless if nothing is wired to GPIO15 yet.
void setRedSolo(bool on) {
  digitalWrite(RED_LED_SOLO_PIN, on ? HIGH : LOW);
}

// Ramps GPIO21 on over ~60ms by hand-toggling with an increasing duty cycle,
// instead of switching it HIGH in one step. A sudden step is what draws the
// inrush spike that sags the rail; spreading it over 60ms lets the supply
// keep up. Written with digitalWrite/delayMicroseconds rather than the LEDC
// PWM API so it compiles on any ESP32 core version.
// Only used when DENY_ALERT_ENABLED is true.
void softStartAlert() {
  const int STEPS = 20;
  for (int step = 1; step <= STEPS; step++) {
    for (int cycle = 0; cycle < 3; cycle++) {
      digitalWrite(RED_LED_BUZZER_PIN, HIGH);
      delayMicroseconds(step * 50);
      digitalWrite(RED_LED_BUZZER_PIN, LOW);
      delayMicroseconds((STEPS - step) * 50);
    }
  }
  digitalWrite(RED_LED_BUZZER_PIN, HIGH);   // fully on after the ramp
}

// ===========================================================================
// TFT
// ===========================================================================
// Every screen is composed in RAM (a 160x128 canvas, 40 KB) and sent to the
// display in ONE transfer (~16 ms at 20 MHz). The panel therefore never shows
// a half-drawn screen - no clear-then-draw flicker, no text appearing line by
// line - which is what makes each change look like a clean cut.
// If the canvas cannot be allocated, the same screens are drawn directly.
// ===========================================================================
GFXcanvas16 *canvas = nullptr;

Adafruit_GFX &gfx() {
  if (canvas) return *canvas;
  return tft;
}

void present() {
  if (canvas) tft.drawRGBBitmap(0, 0, canvas->getBuffer(), 160, 128);
}

// Full (re)initialisation: hardware reset pulse + the library's whole
// command list. ~0.8 s, and the panel shows white while it runs, so it is
// used at boot and after a buzzer surge only.
void tftInit() {
  static bool spiStarted = false;
  if (!spiStarted) {
    tftSPI.begin(TFT_SCK_PIN, -1, TFT_MOSI_PIN, TFT_CS_PIN);
    pinMode(TFT_RST_PIN, OUTPUT);
    spiStarted = true;
  }
  if (!canvas) {
    canvas = new GFXcanvas16(160, 128);
    if (!canvas->getBuffer()) { delete canvas; canvas = nullptr; }
  }
  digitalWrite(TFT_RST_PIN, LOW);  delay(10);
  digitalWrite(TFT_RST_PIN, HIGH); delay(120);
  tft.initR(INITR_BLACKTAB);
  tft.setSPISpeed(TFT_SPI_HZ);
  tft.setRotation(3);
  displayDirty = true;
}

// Light recovery after a supply dip (~125 ms, no reset pulse, no flash).
// If the dip reset the controller, it is asleep in its defaults: wake it,
// set 16-bit colour and orientation, switch the panel on. If it did NOT
// reset, every one of these commands is harmless and nothing visibly
// changes.
void tftWake() {
  tft.sendCommand(ST77XX_SLPOUT);
  delay(120);                                   // datasheet: 120 ms after SLPOUT
  uint8_t colmod = 0x05;                        // 16-bit RGB565
  tft.sendCommand(ST77XX_COLMOD, &colmod, 1);
  tft.setRotation(3);                           // rewrites MADCTL
  tft.sendCommand(ST77XX_DISPON);
}

// --- palette ---------------------------------------------------------------
constexpr uint16_t rgb(uint8_t r, uint8_t g, uint8_t b) {
  return ((r & 0xF8) << 8) | ((g & 0xFC) << 3) | (b >> 3);
}
constexpr uint16_t C_BG       = rgb(8, 16, 36);     // deep navy
constexpr uint16_t C_HEADER   = rgb(22, 36, 66);
constexpr uint16_t C_WHITE    = 0xFFFF;
constexpr uint16_t C_SUB      = rgb(175, 195, 225); // soft blue-grey
constexpr uint16_t C_ACCENT   = rgb(90, 200, 255);  // cyan
constexpr uint16_t C_OK       = rgb(0, 160, 70);    // success green
constexpr uint16_t C_OK_DARK  = rgb(0, 105, 45);
constexpr uint16_t C_OK_LIGHT = rgb(150, 255, 180);
constexpr uint16_t C_BAD      = rgb(205, 20, 25);   // failure red
constexpr uint16_t C_BAD_DARK = rgb(125, 10, 12);
constexpr uint16_t C_WARN     = rgb(255, 190, 0);   // amber
constexpr uint16_t C_TRACK    = rgb(40, 55, 85);

// --- text helpers ----------------------------------------------------------
// Draws text horizontally centred with its TOP at y, in the given font
// (nullptr = the small built-in font). Custom fonts draw from the baseline,
// so the bounds are measured first and the cursor shifted accordingly.
void centerText(Adafruit_GFX &g, const char *t, const GFXfont *font,
                int16_t y, uint16_t color) {
  if (!t || !*t) return;
  g.setFont(font);
  g.setTextSize(1);
  g.setTextWrap(false);
  int16_t x1, y1; uint16_t w, h;
  g.getTextBounds(t, 0, 0, &x1, &y1, &w, &h);
  g.setCursor((160 - (int16_t)w) / 2 - x1, y - y1);
  g.setTextColor(color);
  g.print(t);
  g.setFont(nullptr);
}

// The largest bold font the text fits in: 12pt, then 9pt, then built-in.
const GFXfont *fitFont(Adafruit_GFX &g, const char *t) {
  const GFXfont *fonts[] = { &FreeSansBold12pt7b, &FreeSansBold9pt7b };
  for (const GFXfont *f : fonts) {
    g.setFont(f);
    int16_t x1, y1; uint16_t w, h;
    g.getTextBounds(t, 0, 0, &x1, &y1, &w, &h);
    g.setFont(nullptr);
    if (w <= 152) return f;
  }
  return nullptr;
}

void header(Adafruit_GFX &g, uint16_t color, const char *left) {
  g.fillRect(0, 0, 160, 14, color);
  g.setFont(nullptr);
  g.setTextSize(1);
  g.setTextColor(C_WHITE);
  g.setCursor(4, 3);
  g.print(left);
  g.setCursor(160 - 4 - 6 * strlen(LAB_ID), 3);
  g.print(LAB_ID);
}

void iconCheck(Adafruit_GFX &g, int16_t cx, int16_t cy, uint16_t ring, uint16_t mark) {
  g.fillCircle(cx, cy, 15, ring);
  for (int d = -2; d <= 2; d++) {
    g.drawLine(cx - 8, cy + d, cx - 3, cy + 5 + d, mark);
    g.drawLine(cx - 3, cy + 5 + d, cx + 8, cy - 6 + d, mark);
  }
}

void iconCross(Adafruit_GFX &g, int16_t cx, int16_t cy, uint16_t ring, uint16_t mark) {
  g.fillCircle(cx, cy, 15, ring);
  for (int d = -2; d <= 2; d++) {
    g.drawLine(cx - 7 + d, cy - 7, cx + 7 + d, cy + 7, mark);
    g.drawLine(cx + 7 + d, cy - 7, cx - 7 + d, cy + 7, mark);
  }
}

// Short, human wording for the reason codes the door and the portal use.
const char *friendlyReason(const char *code) {
  struct { const char *code, *text; } map[] = {
    {"FACE MISMATCH",         "Face does not match"},
    {"WRONG FINGER",          "Fingerprint mismatch"},
    {"FINGER TIMEOUT",        "Timed out - try again"},
    {"UNKNOWN CARD",          "Card not recognised"},
    {"UNKNOWN QR",            "QR not recognised"},
    {"NOT ENROLLED",          "Not enrolled at door"},
    {"TOKEN_UNKNOWN",         "QR not recognised"},
    {"TOKEN_REVOKED",         "QR was replaced"},
    {"BOOKING_NOT_STARTED",   "Booking not started"},
    {"BOOKING_EXPIRED",       "Booking has ended"},
    {"BOOKING_CANCELLED",     "Booking cancelled"},
    {"BOOKING_NOT_CONFIRMED", "Booking not confirmed"},
    {"WRONG_LAB",             "Booked for other lab"},
    {"USER_INACTIVE",         "Account disabled"},
    {"NO_ENROLLED_IDENTITY",  "No biometric enrolled"},
    {"NO_NETWORK",            "Portal unreachable"},
    {"BACKEND_DISABLED",      "Portal disabled"},
  };
  if (!code) return "";
  for (auto &m : map) if (strcmp(code, m.code) == 0) return m.text;
  if (strncmp(code, "HTTP_", 5) == 0) return "Portal unreachable";
  return code;
}

bool cameraHealthy();   // defined with the camera polling

// --- screens ---------------------------------------------------------------
void screenBoot(Adafruit_GFX &g) {
  g.fillScreen(C_BG);
  header(g, C_HEADER, "SMART LAB");
  centerText(g, "SMART LAB", &FreeSansBold12pt7b, 42, C_WHITE);
  centerText(g, "Starting...", nullptr, 76, C_SUB);
}

void screenIdle(Adafruit_GFX &g) {
  g.fillScreen(C_BG);
  header(g, C_HEADER, "SMART LAB");
  centerText(g, "WELCOME", &FreeSansBold12pt7b, 26, C_WHITE);
  centerText(g, "Scan your QR code", nullptr, 56, C_SUB);
  centerText(g, "or RFID tag / card", nullptr, 68, C_SUB);
  // Say what does NOT work, so nobody waits at a dead reader.
  const char *note = nullptr;
  if (rfidLinkDown && !cameraHealthy()) note = "Readers offline - call staff";
  else if (rfidLinkDown)                note = "RFID offline - use QR code";
  else if (!cameraHealthy())            note = "Camera offline - use card";
  if (note) centerText(g, note, nullptr, 90, C_WARN);
  centerText(g, "STEP 1 OF 2", nullptr, 112, C_ACCENT);
}

void screenChecking(Adafruit_GFX &g) {
  g.fillScreen(C_BG);
  header(g, C_HEADER, "SMART LAB");
  centerText(g, "CHECKING", &FreeSansBold12pt7b, 34, C_WARN);
  centerText(g, "Booking QR code found", nullptr, 66, C_WHITE);
  centerText(g, "One moment...", nullptr, 80, C_SUB);
}

void screenStep1Ok(Adafruit_GFX &g) {
  const char *name = authorizedUsers[pendingUserIndex].displayName;
  g.fillScreen(C_OK);
  header(g, C_OK_DARK, "SMART LAB");
  iconCheck(g, 80, 38, C_WHITE, C_OK);
  centerText(g, step1Label, &FreeSansBold9pt7b, 60, C_WHITE);
  centerText(g, name, fitFont(g, name), 84, C_WHITE);
}

// Remaining-time bar for step 2, drawn straight to the panel: it changes
// several times a second and is only 150x6 pixels.
void drawVerifyBar() {
  uint32_t used = millis() - stateEnteredMs;
  uint32_t left = used >= FINGERPRINT_TIMEOUT_MS ? 0 : FINGERPRINT_TIMEOUT_MS - used;
  int16_t w = (int32_t)150 * left / FINGERPRINT_TIMEOUT_MS;
  uint16_t c = left < 5000 ? C_WARN : C_OK;
  tft.fillRect(5, 116, w, 6, c);
  tft.fillRect(5 + w, 116, 150 - w, 6, C_TRACK);
}

void screenVerify(Adafruit_GFX &g) {
  const char *name = authorizedUsers[pendingUserIndex].displayName;
  g.fillScreen(C_BG);
  header(g, C_HEADER, "SMART LAB");
  centerText(g, "VERIFY", &FreeSansBold12pt7b, 20, C_WHITE);
  centerText(g, name, &FreeSansBold9pt7b, 44, C_OK_LIGHT);
  centerText(g, "Look at the camera", nullptr, 66, C_WHITE);
  centerText(g, "or place your finger", nullptr, 78, C_WHITE);
  centerText(g, "STEP 2 OF 2", nullptr, 98, C_ACCENT);
  g.fillRect(5, 116, 150, 6, C_OK);             // full; drawVerifyBar shrinks it
}

// Identical for ACCESS_GRANTED and DOOR_UNLOCKED_WAIT_OPEN, so moving
// between the two changes nothing on the panel.
void screenGranted(Adafruit_GFX &g) {
  const char *name = authorizedUsers[pendingUserIndex].displayName;
  const uint16_t *photo = userPhoto(authorizedUsers[pendingUserIndex].name);
  if (photo) {
    // Photo full screen; the name on a green band at the top, ACCESS
    // GRANTED on a green band below the chin.
    if (canvas) memcpy(canvas->getBuffer(), photo, 160 * 128 * 2);
    else tft.drawRGBBitmap(0, 0, const_cast<uint16_t *>(photo), 160, 128);
    g.fillRect(0, 0, 160, 22, C_OK);
    centerText(g, name, &FreeSansBold9pt7b, 4, C_WHITE);
    g.fillRect(0, 84, 160, 44, C_OK);
    centerText(g, "ACCESS", &FreeSansBold12pt7b, 86, C_WHITE);
    centerText(g, "GRANTED", &FreeSansBold12pt7b, 107, C_WHITE);
    return;
  }
  g.fillScreen(C_OK);
  header(g, C_OK_DARK, "DOOR UNLOCKED");
  iconCheck(g, 80, 34, C_WHITE, C_OK);
  centerText(g, "ACCESS", &FreeSansBold12pt7b, 54, C_WHITE);
  centerText(g, "GRANTED", &FreeSansBold12pt7b, 76, C_WHITE);
  centerText(g, name, &FreeSansBold9pt7b, 104, C_WHITE);
}

void screenDoorOpen(Adafruit_GFX &g) {
  if (heldOpenAlarmed) {
    g.fillScreen(C_BAD);
    header(g, C_BAD_DARK, "DOOR HELD OPEN");
    centerText(g, "CLOSE", &FreeSansBold12pt7b, 26, C_WHITE);
    centerText(g, "THE DOOR", &FreeSansBold12pt7b, 50, C_WHITE);
    centerText(g, "Open for too long", nullptr, 84, C_WHITE);
    centerText(g, "Staff have been notified", nullptr, 98, C_WHITE);
    return;
  }
  g.fillScreen(C_BG);
  header(g, C_HEADER, "SMART LAB");
  centerText(g, "DOOR OPEN", &FreeSansBold12pt7b, 34, C_WHITE);
  centerText(g, "Please close the door", nullptr, 70, C_SUB);
  centerText(g, "behind you", nullptr, 82, C_SUB);
}

void screenDenied(Adafruit_GFX &g) {
  g.fillScreen(C_BAD);
  header(g, C_BAD_DARK, "DOOR LOCKED");
  iconCross(g, 80, 34, C_WHITE, C_BAD);
  centerText(g, "ACCESS", &FreeSansBold12pt7b, 54, C_WHITE);
  centerText(g, "DENIED", &FreeSansBold12pt7b, 76, C_WHITE);
  centerText(g, friendlyReason(deniedReason), nullptr, 106, C_WHITE);
}

void screenAlarm(Adafruit_GFX &g) {
  g.fillScreen(C_BAD);
  header(g, C_BAD_DARK, "! SECURITY ALERT !");
  centerText(g, "FORCED", &FreeSansBold12pt7b, 24, C_WHITE);
  centerText(g, "ENTRY", &FreeSansBold12pt7b, 48, C_WHITE);
  centerText(g, "Door opened while locked", nullptr, 80, C_WHITE);
  centerText(g, "Staff have been notified", nullptr, 94, C_WHITE);
  centerText(g, "Please close the door", nullptr, 108, C_WHITE);
}

// Shown by the QR path while the portal is asked - outside updateDisplay()
// because the state does not change until the answer arrives.
void showChecking() {
  screenChecking(gfx());
  present();
}

void updateDisplay() {
  if (!displayDirty) return;
  displayDirty = false;

  Adafruit_GFX &g = gfx();
  switch (state) {
    case STATE_IDLE:                    screenIdle(g); break;
    case STATE_WAIT_FINGERPRINT:
      if (verifyPromptShown) screenVerify(g); else screenStep1Ok(g);
      break;
    case STATE_ACCESS_GRANTED:
    case STATE_DOOR_UNLOCKED_WAIT_OPEN: screenGranted(g); break;
    case STATE_DOOR_OPEN_WAIT_CLOSE:    screenDoorOpen(g); break;
    case STATE_ACCESS_DENIED:           screenDenied(g); break;
    case STATE_DOOR_ALARM:              screenAlarm(g); break;
  }
  present();
}

// ===========================================================================
// CAMERA POLLING
// ===========================================================================
// Pulls /status from the camera board and caches the result. Non-blocking in
// the sense that it runs on a timer and uses a short HTTP timeout - a camera
// that is off or slow costs us CAMERA_TIMEOUT_MS at worst, and the RFID and
// fingerprint paths keep working regardless.
// ===========================================================================
String jsonStr(const String &src, const String &key) {
  int k = src.indexOf("\"" + key + "\"");
  if (k < 0) return "";
  int colon = src.indexOf(':', k);
  if (colon < 0) return "";
  int comma = src.indexOf(',', colon);
  int brace = src.indexOf('}', colon);
  int end   = (comma >= 0 && comma < brace) ? comma : brace;
  int q1 = src.indexOf('"', colon);
  if (q1 < 0 || q1 > end) return "";        // value was null
  int q2 = src.indexOf('"', q1 + 1);
  if (q2 < 0) return "";
  return src.substring(q1 + 1, q2);
}

long jsonLong(const String &src, const String &key) {
  int k = src.indexOf("\"" + key + "\"");
  if (k < 0) return -1;
  int colon = src.indexOf(':', k);
  if (colon < 0) return -1;
  return src.substring(colon + 1).toInt();
}

void pollCamera() {
  if (WiFi.status() != WL_CONNECTED) { cameraOnline = false; return; }

  // STATIC, not local: HTTPClient can only keep a connection alive across
  // calls if the object survives between them. Re-opening a TCP connection
  // four times a second is the single biggest avoidable delay in the poll.
  static WiFiClient  client;
  static HTTPClient  http;
  http.begin(client, String("http://") + CAMERA_IP + "/status");
  http.setReuse(true);
  http.setConnectTimeout(CAMERA_TIMEOUT_MS);
  http.setTimeout(CAMERA_TIMEOUT_MS);
  int code = http.GET();

  if (code != 200) {
    http.end();
    if (cameraOnline) Serial.println("[CAM] camera unreachable - RFID/finger still work");
    cameraOnline = false;
    visionQrFresh = visionFaceFresh = false;
    return;
  }

  String body = http.getString();
  http.end();
  cameraOnline = true;
  lastCameraOkMs = millis();

  // FRESHNESS IS THE SECURITY CHECK. An old QR or face must never authorize
  // the person standing there now.
  long qrAge   = jsonLong(body, "qr_age_ms");
  long faceAge = jsonLong(body, "face_age_ms");

  visionQr        = jsonStr(body, "qr");
  visionFace      = jsonStr(body, "face");
  visionQrFresh   = (visionQr.length()   > 0) && (qrAge   >= 0) && (qrAge   < VISION_FRESH_MS);
  visionFaceFresh = (visionFace.length() > 0) && (faceAge >= 0) && (faceAge < VISION_FRESH_MS);
  int d = body.indexOf("\"distance\":");
  visionDistance = d >= 0 ? body.substring(d + 11).toFloat() : 0;
}

// The camera counts as healthy while it answered within CAMERA_HEALTHY_MS.
// A single slow poll is not an outage.
bool cameraHealthy() {
  return lastCameraOkMs != 0 && millis() - lastCameraOkMs < CAMERA_HEALTHY_MS;
}

// Finds a user by their INTERNAL name (USER1 / USER2) - this is what the
// camera and face server report. Deliberately not the display name.
// ===========================================================================
// PORTAL CLIENT
// ===========================================================================
// Two rules govern everything in this section.
//
// FAIL CLOSED. A portal-issued booking QR is authorized by the backend or it
// is refused. Network down, server down, timeout, malformed reply - all of
// them deny. There is no path here that reaches goWaitFingerprint() without
// a positive "valid":true from the server. A laboratory that requires a
// booking must not become an open door because a laptop crashed.
//
// THE RELAY IS NEVER TOUCHED FROM HERE. Nothing in this file calls
// setRelay(). The backend returns an identity; the state machine still
// requires the biometric second factor to match it before the door opens.
// ===========================================================================

String backendBase() {
  return String("http://") + BACKEND_IP + ":" + String(BACKEND_PORT) + "/api";
}

QrAuthResult validateQrWithBackend(const String &token) {
  QrAuthResult out;

  if (!BACKEND_ENABLED) {
    out.reason = "BACKEND_DISABLED";
    return out;                       // fail closed
  }
  if (WiFi.status() != WL_CONNECTED) {
    out.reason = "NO_NETWORK";
    Serial.println("[PORTAL] No WiFi - booking QR DENIED (fail closed).");
    return out;                       // fail closed
  }

  static WiFiClient client;
  static HTTPClient http;

  http.begin(client, backendBase() + "/access/validate-qr");
  http.setReuse(true);
  http.setConnectTimeout(BACKEND_TIMEOUT_MS);
  http.setTimeout(BACKEND_TIMEOUT_MS);
  http.addHeader("Content-Type", "application/json");
  http.addHeader("X-Device-Key", DEVICE_KEY);

  String body = String("{\"lab_id\":\"") + LAB_ID +
                "\",\"qr_token\":\"" + token +
                "\",\"device_uid\":\"" + DEVICE_ID + "\"}";

  int code = http.POST(body);

  if (code != 200) {
    // Any transport failure is a denial, not a fallback to local rules.
    out.reason = String("HTTP_") + code;
    Serial.printf("[PORTAL] validate-qr failed (HTTP %d) - DENIED.\n", code);
    http.end();
    return out;
  }

  String reply = http.getString();
  http.end();

  // The reply must positively say valid:true. Absence is denial.
  if (reply.indexOf("\"valid\":true") < 0) {
    out.reason = jsonStr(reply, "reason");
    if (out.reason.length() == 0) out.reason = "DENIED";
    Serial.printf("[PORTAL] Booking QR rejected: %s\n", out.reason.c_str());
    return out;
  }

  out.valid       = true;
  out.authSubject = jsonStr(reply, "auth_subject");
  out.displayName = jsonStr(reply, "display_name");
  out.bookingId   = jsonLong(reply, "booking_id");

  // A validated booking with no auth_subject cannot be checked against a
  // biometric, so it cannot be used as step 1. Denying here rather than
  // later keeps the identity-binding rule absolute.
  if (out.authSubject.length() == 0) {
    out.valid  = false;
    out.reason = "NO_ENROLLED_IDENTITY";
    Serial.println("[PORTAL] Booking has no enrolled biometric identity - DENIED.");
  }
  return out;
}

// ---------------------------------------------------------------------------
// Event reporting. Fire and forget: the door must never wait on the portal.
// A failure here costs an audit-log line, not an entry decision.
// ---------------------------------------------------------------------------
void reportEvent(const char *eventType, const char *authSubject,
                 long bookingId, const char *method, const char *result,
                 const char *reason, const String &message) {
  if (!BACKEND_ENABLED || WiFi.status() != WL_CONNECTED) return;

  static WiFiClient client;
  static HTTPClient http;

  const char *path = "/access/events";
  if (strcmp(eventType, "ACCESS_GRANTED") == 0) path = "/access/grant";
  else if (strcmp(eventType, "ACCESS_DENIED") == 0) path = "/access/deny";

  http.begin(client, backendBase() + path);
  http.setReuse(true);
  http.setConnectTimeout(BACKEND_TIMEOUT_MS);
  http.setTimeout(BACKEND_TIMEOUT_MS);
  http.addHeader("Content-Type", "application/json");
  http.addHeader("X-Device-Key", DEVICE_KEY);

  String body = String("{\"lab_id\":\"") + LAB_ID +
                "\",\"device_uid\":\"" + DEVICE_ID +
                "\",\"event_type\":\"" + eventType + "\"";
  if (authSubject && strlen(authSubject)) body += String(",\"auth_subject\":\"") + authSubject + "\"";
  if (bookingId >= 0)                     body += String(",\"booking_id\":") + bookingId;
  if (method && strlen(method))           body += String(",\"method\":\"") + method + "\"";
  if (result && strlen(result))           body += String(",\"result\":\"") + result + "\"";
  if (reason && strlen(reason))           body += String(",\"reason\":\"") + reason + "\"";
  body += String(",\"message\":\"") + message + "\"}";

  int code = http.POST(body);
  if (code != 200) Serial.printf("[PORTAL] event %s not recorded (HTTP %d)\n",
                                 eventType, code);
  http.end();
}

void sendHeartbeat() {
  if (!BACKEND_ENABLED || WiFi.status() != WL_CONNECTED) return;

  static WiFiClient client;
  static HTTPClient http;

  http.begin(client, backendBase() + "/access/heartbeat");
  http.setReuse(true);
  http.setConnectTimeout(BACKEND_TIMEOUT_MS);
  http.setTimeout(BACKEND_TIMEOUT_MS);
  http.addHeader("Content-Type", "application/json");
  http.addHeader("X-Device-Key", DEVICE_KEY);

  String body = String("{\"device_uid\":\"") + DEVICE_ID +
                "\",\"lab_id\":\"" + LAB_ID +
                "\",\"ip_address\":\"" + WiFi.localIP().toString() +
                "\",\"firmware_version\":\"portal-1.0\"" +
                ",\"door_closed\":" + (doorClosed ? "true" : "false") +
                // Per-component health for the admin view. The LCD is not
                // here: its bus has no return line, so a dead display
                // cannot be detected from the ESP32.
                ",\"components\":{\"rfid\":" + (rfidLinkDown ? "false" : "true") +
                ",\"fingerprint\":" + (fpOk ? "true" : "false") +
                ",\"camera\":" + (cameraHealthy() ? "true" : "false") +
                ",\"relay_locked\":" + (relayUnlocked ? "false" : "true") + "}}";
  http.POST(body);
  http.end();
}


int findUserByName(const String &n) {
  for (size_t i = 0; i < AUTHORIZED_USER_COUNT; i++) {
    if (n.equals(authorizedUsers[i].name)) return (int)i;
  }
  return -1;
}

// "USER7" -> 7, anything else -> 0.
uint8_t slotFromSubject(const String &subject) {
  if (!subject.startsWith("USER") || subject.length() < 5 || subject.length() > 7) return 0;
  long n = 0;
  for (size_t i = 4; i < subject.length(); i++) {
    char c = subject[i];
    if (c < '0' || c > '9') return 0;
    n = n * 10 + (c - '0');
  }
  return (n >= 1 && n <= MAX_FINGER_SLOT) ? (uint8_t)n : 0;
}

// A portal-authorized identity that is not in the fixed table: load it into
// PORTAL_SLOT so step 2 checks fingerprint slot n / face label USERn.
// Returns PORTAL_SLOT, or -1 if the subject is not of the USERn form.
int usePortalIdentity(const String &subject, const String &fullName) {
  uint8_t slot = slotFromSubject(subject);
  if (slot == 0) return -1;
  strncpy(portalUserName, subject.c_str(), sizeof(portalUserName) - 1);
  portalUserName[sizeof(portalUserName) - 1] = '\0';
  // LCD: first name in capitals, as for the fixed users.
  String first = fullName;
  first.trim();
  int sp = first.indexOf(' ');
  if (sp > 0) first = first.substring(0, sp);
  first.toUpperCase();
  if (first.length() == 0) first = subject;
  strncpy(portalUserDisplay, first.c_str(), sizeof(portalUserDisplay) - 1);
  portalUserDisplay[sizeof(portalUserDisplay) - 1] = '\0';
  authorizedUsers[PORTAL_SLOT].fingerprintId = slot;
  return PORTAL_SLOT;
}

// ===========================================================================
// State transitions
// ===========================================================================
void enterState(SystemState s) {
  state = s;
  stateEnteredMs = millis();
  displayDirty = true;
}

void goIdle() {
  Serial.println("[STATE] -> IDLE");
  setIndicators(false, false);
  setRedSolo(false);
  setRelay(false);                 // no-op if already locked (e.g. after a denial)
  pendingUserIndex = -1;
  // Clear portal context too, or a later entry could be logged against an
  // earlier person's booking.
  pendingBookingId = -1;
  pendingViaPortal = false;
  enterState(STATE_IDLE);
}

void goWaitFingerprint(int userIndex) {
  pendingUserIndex = userIndex;
  Serial.printf("[STATE] -> WAIT_FINGERPRINT (%s / %s)\n",
                authorizedUsers[userIndex].displayName,
                authorizedUsers[userIndex].name);
  verifyPromptShown = false;
  enterState(STATE_WAIT_FINGERPRINT);
}

// The ONLY place the door is ever unlocked.
// factorEvent/factorMethod/factorMsg describe the step-2 match (face or
// fingerprint). They used to be reported BEFORE this was called, so every
// entry waited on a portal round trip before the lock opened. Now the door
// unlocks and the screen updates first; both audit lines follow, in the
// same order as before.
void goAccessGranted(const char *factorEvent, const char *factorMethod,
                     const String &factorMsg) {
  Serial.printf("[AUTH][GRANTED] %s (%s) - %s matched\n",
                authorizedUsers[pendingUserIndex].displayName,
                authorizedUsers[pendingUserIndex].name, factorMethod);
  setIndicators(true, false);      // GREEN ON at grant, per spec
  setRelay(true);                  // relay LOW -> unlocked
  enterState(STATE_ACCESS_GRANTED);

  // The coil switching on is the supply dip that can reset the ST7735 to
  // white. Drawing straight into that dip left the screen white, so let the
  // rail settle, wake the controller in case it reset (there is no way to
  // read it back), and only then draw the grant screen.
  uint32_t t0 = millis();
  delay(RELAY_SETTLE_MS);
  tftWake();
  displayDirty = true;
  updateDisplay();                 // show the grant now, not after the reports
  Serial.printf("[TFT] grant screen shown %u ms after unlock\n",
                (unsigned)(millis() - t0));

  // Reported AFTER the door is already unlocked. The portal is a witness to
  // this decision, not a participant in it - if the report fails, the person
  // still gets in, and only the audit line is lost.
  reportEvent(factorEvent, authorizedUsers[pendingUserIndex].name,
              pendingBookingId, factorMethod, "GRANTED", "", factorMsg);
  reportEvent("ACCESS_GRANTED", authorizedUsers[pendingUserIndex].name,
              pendingBookingId, pendingViaPortal ? "QR" : "RFID", "GRANTED",
              "", String("Access granted to ") +
              authorizedUsers[pendingUserIndex].displayName);
}

void goAccessDenied(const char *reason) {
  Serial.printf("[AUTH][DENIED] %s\n", reason);
  strncpy(deniedReasonBuf, reason, sizeof(deniedReasonBuf) - 1);
  deniedReasonBuf[sizeof(deniedReasonBuf) - 1] = '\0';
  deniedReason = deniedReasonBuf;

  // ORDER MATTERS. Draw the DENIED screen FIRST, while the supply is still
  // clean. Previously the buzzer was energized before this, so the TFT was
  // being written to during the voltage sag - which is what reset it to a
  // white screen mid-draw.
  enterState(STATE_ACCESS_DENIED);
  updateDisplay();

  // NO RELAY COMMAND. Every denial path already has the door locked - an
  // unknown card is rejected from IDLE, a wrong finger is rejected before
  // any unlock happened. The relay is left exactly as it is.

  // Only now fire the alert - soft-started, and as a SHORT pulse rather than
  // a 2s hold. Disabled by default; see DENY_ALERT_ENABLED above.
  if (DENY_ALERT_ENABLED) {
    Serial.printf("[DENY] Firing alert on GPIO21 (soft-start, %ums hold)...\n",
                  (unsigned)DENY_BEEP_MS);
    // Straight ON, no soft-start ramp here. The ramp itself takes ~60ms of
    // switching, which defeats the whole point of a 30ms pulse.
    digitalWrite(RED_LED_BUZZER_PIN, HIGH);
    denyAlertActive  = true;
    denyAlertStartMs = millis();
    denyAlertFired   = true;
  } else {
    Serial.println("[DENY] Buzzer suppressed (DENY_ALERT_ENABLED = false) - "
                   "relay left completely undisturbed.");
  }

  // Standalone red LED always fires - tiny current, cannot disturb the relay.
  setRedSolo(true);

  // Report the denial with whatever identity context exists. The QR path
  // reports its own richer denial before calling this, so a duplicate here
  // is harmless and an omission would not be.
  reportEvent("ACCESS_DENIED",
              pendingUserIndex >= 0 ? authorizedUsers[pendingUserIndex].name : "",
              pendingBookingId, pendingViaPortal ? "QR" : "RFID", "DENIED",
              reason, String("Denied at door: ") + reason);
}

void goDoorOpenWaitClose() {
  Serial.println("[DOOR] Door OPEN detected");
  reportEvent("DOOR_OPENED",
              pendingUserIndex >= 0 ? authorizedUsers[pendingUserIndex].name : "",
              pendingBookingId, "", "", "", "Door opened");
  heldOpenAlarmed = false;
  enterState(STATE_DOOR_OPEN_WAIT_CLOSE);
}

// The door opened although nobody was granted access: the relay was locked,
// so it was forced (or the lock failed). Red LED + red screen until it is
// closed again; the portal raises a critical alert.
void goDoorAlarm() {
  Serial.println("[ALARM] Door opened while LOCKED - forced entry");
  setIndicators(false, false);
  setRedSolo(true);
  pendingUserIndex = -1;
  pendingBookingId = -1;
  pendingViaPortal = false;
  enterState(STATE_DOOR_ALARM);
  updateDisplay();
  reportEvent("ALARM", "", -1, "", "", "FORCED_ENTRY",
              "Door opened while locked - no access had been granted");
}

void goRelockAndIdle() {
  Serial.println("[DOOR] Door CLOSED - relocking");
  // Reported BEFORE goIdle(), which clears the portal context - otherwise
  // the closure would be logged with no booking attached.
  reportEvent("DOOR_CLOSED",
              pendingUserIndex >= 0 ? authorizedUsers[pendingUserIndex].name : "",
              pendingBookingId, "", "", "", "Door closed - relocked");
  goIdle();
}

// ===========================================================================
// Fingerprint — one non-blocking attempt; returns matched ID or -1
// ===========================================================================
int tryReadFingerprint() {
  if (finger.getImage()         != FINGERPRINT_OK) return -1;
  if (finger.image2Tz()         != FINGERPRINT_OK) return -1;
  if (finger.fingerFastSearch() != FINGERPRINT_OK) return -1;
  return finger.fingerID;
}

// ===========================================================================
// Fingerprint enrolment from the serial monitor (maintenance, door locked)
//   enroll 5        store a finger in slot 5  (= portal identity USER5)
//   enroll 5 force  overwrite slot 5
//   delete 5        remove slot 5
//   count           how many fingerprints are stored
// Serial monitor: 115200 baud, line ending "Newline". Only accepted while
// the door is idle; the lock stays locked throughout.
// ===========================================================================
bool waitFingerImage(uint32_t timeoutMs) {
  uint32_t start = millis();
  while (millis() - start < timeoutMs) {
    uint8_t p = finger.getImage();
    if (p == FINGERPRINT_OK) return true;
    delay(60);
  }
  return false;
}

void waitFingerRemoved(uint32_t timeoutMs) {
  uint32_t start = millis();
  while (millis() - start < timeoutMs && finger.getImage() != FINGERPRINT_NOFINGER) delay(60);
}

void enrollFinger(uint8_t id, bool force) {
  if (!fpOk) { Serial.println("[ENROLL] Fingerprint sensor not available."); return; }
  if (!force && finger.loadModel(id) == FINGERPRINT_OK) {
    Serial.printf("[ENROLL] Slot %u is already used. Type \"enroll %u force\" to overwrite.\n", id, id);
    return;
  }
  Serial.printf("[ENROLL] Slot %u (portal identity USER%u): place the finger on the sensor...\n", id, id);
  if (!waitFingerImage(20000))            { Serial.println("[ENROLL] Timed out - no finger."); return; }
  if (finger.image2Tz(1) != FINGERPRINT_OK) { Serial.println("[ENROLL] Unclear image - try again."); return; }
  Serial.println("[ENROLL] OK. Remove the finger.");
  delay(800);
  waitFingerRemoved(10000);
  Serial.println("[ENROLL] Place the SAME finger again...");
  if (!waitFingerImage(20000))            { Serial.println("[ENROLL] Timed out - no finger."); return; }
  if (finger.image2Tz(2) != FINGERPRINT_OK) { Serial.println("[ENROLL] Unclear image - try again."); return; }
  if (finger.createModel() != FINGERPRINT_OK) {
    Serial.println("[ENROLL] The two scans did not match - try again.");
    return;
  }
  if (finger.storeModel(id) != FINGERPRINT_OK) { Serial.println("[ENROLL] Could not store - try again."); return; }
  Serial.printf("[ENROLL] Stored in slot %u. USER%u can now use this fingerprint with their booking QR.\n", id, id);
}

void runSerialCommand(String line) {
  line.trim();
  line.toLowerCase();
  if (line.length() == 0) return;
  if (state != STATE_IDLE) { Serial.println("[CMD] Busy - try again when the door is idle."); return; }

  if (line == "count") {
    if (fpOk && finger.getTemplateCount() == FINGERPRINT_OK)
      Serial.printf("[CMD] %u fingerprints stored.\n", finger.templateCount);
    else
      Serial.println("[CMD] Fingerprint sensor not available.");
    return;
  }
  bool isEnroll = line.startsWith("enroll ");
  bool isDelete = line.startsWith("delete ");
  if (isEnroll || isDelete) {
    String rest = line.substring(7);
    rest.trim();
    bool force = rest.endsWith(" force");
    if (force) { rest = rest.substring(0, rest.length() - 6); rest.trim(); }
    long id = rest.toInt();
    if (id < 1 || id > MAX_FINGER_SLOT) { Serial.printf("[CMD] Slot must be 1-%u.\n", MAX_FINGER_SLOT); return; }
    if (isEnroll) {
      enrollFinger((uint8_t)id, force);
    } else if (!fpOk) {
      Serial.println("[CMD] Fingerprint sensor not available.");
    } else {
      Serial.println(finger.deleteModel((uint16_t)id) == FINGERPRINT_OK
                     ? "[CMD] Deleted." : "[CMD] Could not delete (empty slot?).");
    }
    goIdle();                      // redraw the idle screen
    return;
  }
  Serial.println("[CMD] Commands: enroll <n> | enroll <n> force | delete <n> | count");
}

void pollSerialCommands() {
  static String line;
  while (Serial.available()) {
    char c = (char)Serial.read();
    if (c == '\r') continue;
    if (c == '\n') { runSerialCommand(line); line = ""; }
    else if (line.length() < 40) line += c;
  }
}

// ===========================================================================
// Door polling — debounced, runs every loop so state never goes stale
// GPIO27 LOW = CLOSED, HIGH = OPEN (confirmed inversion)
// ===========================================================================
void pollDoor() {
  doorChangedThisLoop = false;
  bool raw = (digitalRead(DOOR_PIN) == LOW);   // true = closed
  if (raw != doorClosed) {
    if (millis() - doorLastChangeMs > DOOR_DEBOUNCE_MS) {
      doorClosed = raw;
      doorLastChangeMs = millis();
      doorChangedThisLoop = true;
      Serial.printf("[DOOR] State change -> %s\n", doorClosed ? "CLOSED" : "OPEN");
    }
  } else {
    doorLastChangeMs = millis();
  }
}

// ===========================================================================
// setup()
// ===========================================================================
void setup() {
  // =========================================================================
  // RELAY FIRST - driven LOCKED before anything else. This is the 21:07
  // configuration that kept the door shut. INPUT_PULLUP here is NOT a driven
  // level and left the door sitting open, so it is not used.
  // =========================================================================
  pinMode(RELAY_PIN, OUTPUT);
  digitalWrite(RELAY_PIN, RELAY_LOCKED_LEVEL);
  relayUnlocked   = false;
  relayEverDriven = true;

  Serial.begin(SERIAL_BAUD);
  delay(500);

  Serial.println();
  Serial.println("=================================================");
  Serial.println(" SMART LAB FULL ACCESS CONTROL - FINAL (named users)");
  Serial.println("=================================================");
  Serial.println("[INIT] RELAY GPIO26 driven LOCKED on the first instruction of setup().");
  Serial.println("[INIT] Relay is written ONLY for an access grant and the relock.");

  pinMode(GREEN_LED_PIN, OUTPUT);
  pinMode(RED_LED_BUZZER_PIN, OUTPUT);
  pinMode(RED_LED_SOLO_PIN, OUTPUT);
  digitalWrite(GREEN_LED_PIN, LOW);
  digitalWrite(RED_LED_BUZZER_PIN, LOW);
  digitalWrite(RED_LED_SOLO_PIN, LOW);

  pinMode(DOOR_PIN, INPUT_PULLUP);

  // --- TFT on its own bus ---
  Serial.println("[INIT] Starting ST7735 TFT on separate bus...");
  Serial.println("[INIT] TFT SCK=GPIO13, MOSI=GPIO2 (GPIO4 reserved for fingerprint wiring).");
  tftInit();
  screenBoot(gfx());
  present();

  // --- RFID on the proven VSPI path --- (UNCHANGED)
  Serial.println("[RFID] Initializing the proven standalone VSPI path...");
  rfidBeginSpi();      // ONCE only
  rfidInitReader();

  byte version = mfrc522.PCD_ReadRegister(mfrc522.VersionReg);
  Serial.print("[RFID] VersionReg = 0x");
  printHexByte(version);
  Serial.println();
  if (!rfidVersionOk(version)) {
    Serial.println("[RFID][FAIL] MFRC522 communication check failed.");
    printErrorRegister();
    rfidLinkDown = true;
  } else {
    Serial.println("[RFID][PASS] MFRC522 communication detected.");
    rfidLinkDown = false;
    printAntennaState("[RFID][RF]");
  }


  // --- Fingerprint UART ---
  Serial.println("[FP] Initializing fingerprint sensor...");
  fingerSerial.begin(57600, SERIAL_8N1, FP_RX_PIN, FP_TX_PIN);
  finger.begin(57600);
  fpOk = finger.verifyPassword();
  lastFpCheckMs = millis();
  if (fpOk) {
    Serial.println("[FP][PASS] Fingerprint sensor detected.");
    finger.getTemplateCount();
    Serial.printf("[FP] Stored templates = %u\n", finger.templateCount);
  } else {
    Serial.println("[FP][FAIL] Fingerprint sensor not detected - check wiring.");
  }

  // --- Door sensor initial read ---
  int raw = digitalRead(DOOR_PIN);
  doorClosed = (raw == LOW);
  Serial.printf("[DOOR] GPIO27 raw = %s\n", raw == LOW ? "LOW" : "HIGH");
  Serial.printf("[DOOR] Initial state = %s\n", doorClosed ? "CLOSED" : "OPEN");
  doorLastChangeMs = millis();

  // --- WiFi, for polling the camera board ---------------------------------
  // Deliberately LAST, after every local peripheral is up, and with a bounded
  // timeout. The door must work on RFID + fingerprint even with no network,
  // so a failed connection is a warning, never a fatal error.
  Serial.println("[WIFI] Connecting (camera integration)...");
  WiFi.mode(WIFI_STA);
  WiFi.begin(WIFI_SSID, WIFI_PASS);
  uint32_t wifiStart = millis();
  while (WiFi.status() != WL_CONNECTED && millis() - wifiStart < 12000) {
    delay(250);
    Serial.print(".");
  }
  Serial.println();
  if (WiFi.status() == WL_CONNECTED) {
    WiFi.setSleep(false);
    Serial.print("[WIFI] Connected. Master IP: ");
    Serial.println(WiFi.localIP());
    Serial.printf("[WIFI] Camera expected at %s\n", CAMERA_IP);
  } else {
    Serial.println("[WIFI][WARN] Not connected - QR and FACE unavailable.");
    Serial.println("[WIFI][WARN] RFID + fingerprint continue to work normally.");
  }

  Serial.println();
  Serial.println("=================================================");
  Serial.println("                SYSTEM READY");
  Serial.println("=================================================");
  Serial.println("USER1 (ALI)      -> RFID 89:52:FF:1F (TAG)  + Fingerprint ID 1 (THUMB)");
  Serial.println("USER2 (DR. RAMY) -> RFID F5:77:30:8E (CARD) + Fingerprint ID 2 (INDEX)");
  Serial.println("USER3+ (portal)  -> booking QR + fingerprint slot n / face USERn");
  Serial.println("[READY] Enrol a finger: type \"enroll 5\" (Newline) for USER5. \"help\" lists commands.");
  Serial.println("[READY] STEP 1 (identity) : RFID tag/card  OR  QR code");
  Serial.println("[READY] STEP 2 (biometric): fingerprint    OR  face");
  Serial.println("[READY] Step 2 identity must MATCH step 1 - stolen card is denied.");

  goIdle();
  updateDisplay();   // draw the IDLE screen immediately
}

// ===========================================================================
// loop() — logic identical to the working build
// ===========================================================================
void loop() {
  pollDoor();
  pollSerialCommands();

  // Forced entry: the door opened while the relay was locked and no door
  // cycle was in progress.
  if (doorChangedThisLoop && !doorClosed && !relayUnlocked &&
      (state == STATE_IDLE || state == STATE_WAIT_FINGERPRINT ||
       state == STATE_ACCESS_DENIED)) {
    goDoorAlarm();
  }

  // Component health: report a change at once rather than at the next
  // 30 s heartbeat, so a failure reaches the admin view immediately.
  uint8_t bits = (rfidLinkDown ? 0 : 1) | (fpOk ? 2 : 0) | (cameraHealthy() ? 4 : 0);
  if (bits != lastComponentBits) {
    if (lastComponentBits != 0xFF) {
      Serial.printf("[HEALTH] rfid=%s fingerprint=%s camera=%s\n",
                    bits & 1 ? "ok" : "DOWN", bits & 2 ? "ok" : "DOWN",
                    bits & 4 ? "ok" : "DOWN");
    }
    lastComponentBits = bits;
    lastHeartbeatSentMs = millis();
    sendHeartbeat();
    if (state == STATE_IDLE) displayDirty = true;   // idle screen notes it
  }

  // Device liveness and door state. Cheap, and it is what makes the admin
  // dashboard able to say "controller online" truthfully rather than
  // assuming it.
  if (millis() - lastHeartbeatSentMs > HEARTBEAT_PERIOD_MS) {
    lastHeartbeatSentMs = millis();
    sendHeartbeat();
  }

  // Refresh the vision result on a timer. Runs in every state so a QR seen
  // while idle and a face seen during step 2 are both picked up promptly.
  if (millis() - lastCameraPollMs > CAMERA_POLL_MS) {
    lastCameraPollMs = millis();
    pollCamera();
  }

  switch (state) {

    // -------------------------------------------------------------------
    case STATE_IDLE: {
      // Safe point to repair the display after a relay switch reset it.
      // Only ever runs here, while idle - never during a door cycle.
      // Light wake + clean repaint rather than a full tftInit(): the full
      // reset pulse showed white for most of a second after every relock.
      if (tftRefreshWanted) {
        tftRefreshWanted = false;
        tftWake();
        displayDirty = true;          // full-screen repaint from the canvas
      }

      // Fingerprint sensor self-test (idle only: it shares nothing with the
      // door cycle, and a UART round trip is a few milliseconds).
      if (millis() - lastFpCheckMs > FP_HEALTH_CHECK_MS) {
        lastFpCheckMs = millis();
        fpOk = finger.verifyPassword();
      }

      // Periodic SPI link self-test with automatic recovery.
      if (millis() - lastHeartbeatMs > RFID_HEARTBEAT_MS) {
        lastHeartbeatMs = millis();
        byte v  = mfrc522.PCD_ReadRegister(mfrc522.VersionReg);
        byte tx = mfrc522.PCD_ReadRegister(mfrc522.TxControlReg);
        Serial.printf("[RFID][HEARTBEAT] VersionReg = 0x%02X   TxControlReg = 0x%02X [RF %s]\n",
                      v, tx, ((tx & 0x03) == 0x03) ? "ON" : "OFF");

        // RF field went down while the SPI link is still fine -> re-arm it.
        if (rfidVersionOk(v) && (tx & 0x03) != 0x03) {
          Serial.println("[RFID][RF] Antenna field is OFF - re-enabling...");
          mfrc522.PCD_AntennaOn();
          mfrc522.PCD_SetAntennaGain(MFRC522::RxGain_max);
          printAntennaState("[RFID][RF]");
        }

        if (!rfidVersionOk(v)) {
          bool ok = rfidRecover();
          if (!ok && !rfidLinkDown) { rfidLinkDown = true;  displayDirty = true; }
          if ( ok &&  rfidLinkDown) { rfidLinkDown = false; displayDirty = true; }
        } else if (rfidLinkDown) {
          rfidLinkDown = false;
          displayDirty = true;
          Serial.println("[RFID] Link restored.");
        }
      }

      // ---- STEP 1 ALTERNATIVE: QR code from the camera ----------------
      // Checked before the RFID poll because the RFID call blocks briefly.
      if (visionQrFresh) {
        String payload = visionQr;
        visionQrFresh = false;          // consume it, do not re-trigger

        // ---- Portal-issued booking credential -------------------------
        if (payload.startsWith(PORTAL_QR_PREFIX)) {
          Serial.printf("[QR] Booking token - asking portal (%s)...\n", LAB_ID);
          // Instant feedback: the portal check below takes a moment, and
          // without this the screen sits on "SCAN" as if nothing happened.
          showChecking();
          // No separate QR_SCAN report: validate-qr itself records every
          // attempt (person, booking, lab, device, result and reason), so a
          // prior anonymous "QR presented" event only cost a round trip.

          QrAuthResult auth = validateQrWithBackend(payload);

          if (!auth.valid) {
            // FAIL CLOSED. Backend offline, expired, wrong lab, cancelled -
            // every one of them ends here with the door still shut.
            Serial.printf("[QR][DENIED] %s\n", auth.reason.c_str());
            // goAccessDenied() reports this refusal. Reporting it here as
            // well sent the same ACCESS_DENIED twice - two round trips and
            // two identical security alerts for staff.
            pendingViaPortal = true;    // so that report says method QR
            goAccessDenied(auth.reason.c_str());
            break;
          }

          // The portal names ONE identity. The biometric must match it.
          int qrUser = findUserByName(auth.authSubject);
          if (qrUser < 0) qrUser = usePortalIdentity(auth.authSubject, auth.displayName);
          if (qrUser < 0) {
            Serial.printf("[QR][DENIED] '%s' authorized by portal but not "
                          "enrolled on this reader\n", auth.authSubject.c_str());
            reportEvent("ACCESS_DENIED", auth.authSubject.c_str(), auth.bookingId,
                        "QR", "DENIED", "UNKNOWN_CREDENTIAL",
                        "Portal identity not enrolled locally");
            goAccessDenied("NOT ENROLLED");
            break;
          }

          Serial.printf("[QR][OK] Booking %ld -> %s (%s)\n",
                        auth.bookingId, auth.displayName.c_str(),
                        auth.authSubject.c_str());
          pendingBookingId = auth.bookingId;
          pendingViaPortal = true;
          step1Label = "QR CODE OK";
          goWaitFingerprint(qrUser);
          break;
        }

        // ---- Legacy local payload -------------------------------------
        // Preserved so the bench demo keeps working with the portal off.
        int qrUser = findUserByName(payload);
        Serial.printf("[QR] local payload '%s' -> %s\n", payload.c_str(),
                      qrUser >= 0 ? authorizedUsers[qrUser].displayName : "NOT AUTHORIZED");
        pendingBookingId = -1;
        pendingViaPortal = false;
        if (qrUser >= 0) { step1Label = "QR CODE OK"; goWaitFingerprint(qrUser); break; }
        else             { goAccessDenied("UNKNOWN QR");  break; }
      }

      if (!mfrc522.PICC_IsNewCardPresent()) {
        delay(POLL_DELAY_MS);
        break;
      }
      if (!readCardWithTimeout()) {
        finishRFIDTransaction();
        delay(20);
        break;
      }

      printUID(mfrc522.uid);

      bool duplicate = isSameAsLastUID(mfrc522.uid) &&
                       ((millis() - lastUIDTime) < DUPLICATE_IGNORE_MS);
      if (duplicate) {
        finishRFIDTransaction();
        delay(20);
        break;
      }
      rememberUID(mfrc522.uid);

      int userIndex = findAuthorizedUser(mfrc522.uid);
      finishRFIDTransaction();

      if (userIndex >= 0) { step1Label = "RFID OK"; goWaitFingerprint(userIndex); }
      else                goAccessDenied("UNKNOWN CARD");
      break;
    }

    // -------------------------------------------------------------------
    case STATE_WAIT_FINGERPRINT: {
      if (millis() - stateEnteredMs > FINGERPRINT_TIMEOUT_MS) {
        goAccessDenied("FINGER TIMEOUT");
        break;
      }
      // Display only: the green step-1 confirmation gives way to the
      // step-2 prompt, whose time bar then counts down.
      if (!verifyPromptShown && millis() - stateEnteredMs > STEP1_OK_SHOW_MS) {
        verifyPromptShown = true;
        lastVerifyBarMs = millis();
        displayDirty = true;
      } else if (verifyPromptShown && millis() - lastVerifyBarMs > 250) {
        lastVerifyBarMs = millis();
        drawVerifyBar();
      }
      // ---- STEP 2 ALTERNATIVE: face from the camera -------------------
      // The face identity must match the identity established in step 1.
      // This is what defeats a stolen card: holding someone else's tag and
      // showing your own face is a MISMATCH, not a grant.
      if (visionFaceFresh) {
        String expected = authorizedUsers[pendingUserIndex].name;
        Serial.printf("[FACE] saw %s, expecting %s\n",
                      visionFace.c_str(), expected.c_str());
        bool match = visionFace.equals(expected);
        visionFaceFresh = false;        // consume it
        if (match) {
          goAccessGranted("FACE_ACCEPTED", "FACE",
                          String("Face matched ") + expected + " (distance " +
                          String(visionDistance, 1) + ", accepted up to 70)");
          break;
        } else {
          // The headline security event: a valid step-1 credential presented
          // with somebody else's face. Logged with both identities so the
          // audit trail shows exactly what was attempted.
          reportEvent("IDENTITY_MISMATCH", expected.c_str(), pendingBookingId,
                      "FACE", "DENIED", "IDENTITY_MISMATCH",
                      String("Step 1 was ") + expected + " but face matched " +
                      visionFace + " (distance " + String(visionDistance, 1) + ")");
          goAccessDenied("FACE MISMATCH");
          break;
        }
      }

      int fid = tryReadFingerprint();
      if (fid >= 0) {
        Serial.printf("[FP] Matched fingerprint ID %d\n", fid);
        if (fid == authorizedUsers[pendingUserIndex].fingerprintId) {
          goAccessGranted("FINGERPRINT_ACCEPTED", "FINGERPRINT",
                          "Fingerprint matched");
        } else {
          reportEvent("IDENTITY_MISMATCH",
                      authorizedUsers[pendingUserIndex].name, pendingBookingId,
                      "FINGERPRINT", "DENIED", "IDENTITY_MISMATCH",
                      String("Enrolled finger ID ") + fid +
                      " does not belong to the step 1 identity");
          goAccessDenied("WRONG FINGER");   // enrolled finger, wrong person
        }
      }
      break;
    }

    // -------------------------------------------------------------------
    case STATE_ACCESS_GRANTED: {
      // Opening the door during the grant screen is the normal case now
      // that the screen appears at once. Without this the open was missed
      // (it is only seen on the loop it happens), the cycle waited for an
      // open that had already happened, and relocked after UNLOCK_HOLD_MS
      // with the door standing open.
      if (doorChangedThisLoop && !doorClosed) {
        goDoorOpenWaitClose();
        break;
      }
      if (millis() - stateEnteredMs > GRANTED_DISPLAY_MS) {
        enterState(STATE_DOOR_UNLOCKED_WAIT_OPEN);
      }
      break;
    }

    // -------------------------------------------------------------------
    case STATE_DOOR_UNLOCKED_WAIT_OPEN: {
      if (doorChangedThisLoop && !doorClosed) {
        goDoorOpenWaitClose();
        break;
      }
      if (millis() - stateEnteredMs > UNLOCK_HOLD_MS) {
        Serial.println("[RELAY] Unlock hold elapsed without door opening - relocking (safety default).");
        goRelockAndIdle();
      }
      break;
    }

    // -------------------------------------------------------------------
    case STATE_DOOR_OPEN_WAIT_CLOSE: {
      if (doorChangedThisLoop && doorClosed) {
        goRelockAndIdle();
        break;
      }
      if (!heldOpenAlarmed && millis() - stateEnteredMs > DOOR_HELD_OPEN_MS) {
        heldOpenAlarmed = true;
        Serial.println("[ALARM] Door held open");
        setRedSolo(true);
        displayDirty = true;
        reportEvent("ALARM",
                    pendingUserIndex >= 0 ? authorizedUsers[pendingUserIndex].name : "",
                    pendingBookingId, "", "", "DOOR_HELD_OPEN",
                    String("Door open for more than ") +
                    (DOOR_HELD_OPEN_MS / 1000) + " s");
      }
      break;
    }

    // -------------------------------------------------------------------
    case STATE_DOOR_ALARM: {
      if (doorChangedThisLoop && doorClosed) {
        Serial.println("[ALARM] Door closed again");
        reportEvent("DOOR_CLOSED", "", -1, "", "", "",
                    "Door closed after forced entry");
        goIdle();
      }
      break;
    }

    // -------------------------------------------------------------------
    case STATE_ACCESS_DENIED: {
      // End the alert pulse early - the screen stays up for the full
      // DENIED_DISPLAY_MS, but the current draw stops after DENY_BEEP_MS.
      if (denyAlertActive && (millis() - denyAlertStartMs > DENY_BEEP_MS)) {
        setIndicators(false, false);
        denyAlertActive = false;
      }

      if (millis() - stateEnteredMs > DENIED_DISPLAY_MS) {
        // Recover the display ONLY if the alert fired: its current surge is
        // what can reset the controller to white. A re-init pulses the
        // display's reset line, which itself shows white for a moment - so
        // doing it after every denial (the alert is disabled) is exactly
        // the white flash seen on a face mismatch.
        if (denyAlertFired) tftInit();
        denyAlertFired = false;
        goIdle();
      }
      break;
    }
  }

  updateDisplay();
}
